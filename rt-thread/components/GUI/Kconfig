## rt-thread/components/GUI/Kconfig
```kconfig
menuconfig GUI
    bool "Select GUI"
    default n

if GUI

    config STemWin_GUI
         bool "STemWin"
         default n

    config emWin506_GUI
         bool "emWin506"
         default n

    if emWin506_GUI
        source "$RTT_DIR/components/GUI/emWin506-Src/Kconfig"
    endif

endif
```
